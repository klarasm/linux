## Documentation/devicetree/bindings/clock/spacemit,ccu.yaml
```yaml
# SPDX-License-Identifier: GPL-2.0-only OR BSD-2-Clause
%YAML 1.2
---
$id: http://devicetree.org/schemas/clock/spacemit,ccu.yaml#
$schema: http://devicetree.org/meta-schemas/core.yaml#

title: Spacemit SoC Clock Controller

maintainers:
  - Haylen Chu <heylenay@outlook.com>

properties:
  compatible:
    enum:
      - spacemit,ccu-apbs
      - spacemit,ccu-mpmu
      - spacemit,ccu-apbc
      - spacemit,ccu-apmu

  clocks: true

  clock-names: true

  spacemit,mpmu:
    $ref: /schemas/types.yaml#/definitions/phandle
    description:
      Phandle to the syscon managing "Main PMU (MPMU)" registers

  "#clock-cells":
    const: 1
    description:
      See <dt-bindings/clock/spacemit,ccu.h> for valid indices.

required:
  - compatible
  - "#clock-cells"

additionalProperties: false

allOf:
  - if:
      properties:
        compatible:
          contains:
            const: spacemit,ccu-apbs
    then:
      properties:
        clocks:
          maxItems: 1

        clock-names:
          const: pll1_2457p6_vco

      required:
        - compatible
        - clocks
        - clock-names
        - "#clock-cells"
        - spacemit,mpmu
  - if:
      properties:
        compatible:
          contains:
            const: spacemit,ccu-apbc
    then:
      properties:
        clocks:
          maxItems: 4

        clock-names:
          items:
            - const: clk_32k
            - const: vctcxo_1
            - const: vctcxo_24
            - const: vctcxo_3

      required:
        - compatible
        - clocks
        - clock-names
        - "#clock-cells"

  - if:
      properties:
        compatible:
          contains:
            const: spacemit,ccu-apmu
    then:
      properties:
        clocks:
          maxItems: 1

        clock-names:
          const: vctcxo_24

      required:
        - compatible
        - clocks
        - clock-names
        - "#clock-cells"

examples:
  - |
    syscon_apbs: system-control@d4090000 {
        compatible = "spacemit,mpmu-syscon", "syscon",
        "simple-mfd";
        reg = <0x0 0xd4090000 0x0 0x1000>;

        clk_apbs: clock-controller {
            compatible = "spacemit,ccu-apbs";
            clocks = <&pll1_2457p6_vco>;
            clock-names = "pll1_2457p6_vco";
            #clock-cells = <1>;
            spacemit,mpmu = <&syscon_mpmu>;
        };
    };
```

## drivers/clk/spacemit/Kconfig
```kconfig
# SPDX-License-Identifier: GPL-2.0-only

config SPACEMIT_CCU
	tristate "Clock support for Spacemit SoCs"
	depends on ARCH_SPACEMIT || COMPILE_TEST
	default y
	select MFD_SYSCON
	help
	  This driver supports clock controllers integrated in Spacemit K1
	  SoC. If unsure, say N.
```

## drivers/pinctrl/spacemit/Kconfig
```kconfig
# SPDX-License-Identifier: GPL-2.0-only
#
# Sophgo SoC PINCTRL drivers
#

config PINCTRL_SPACEMIT_K1
	tristate "SpacemiT K1 SoC Pinctrl driver"
	depends on ARCH_SPACEMIT || COMPILE_TEST
	depends on OF
	select GENERIC_PINCTRL_GROUPS
	select GENERIC_PINMUX_FUNCTIONS
	select GENERIC_PINCONF
	help
	  Say Y to select the pinctrl driver for K1 SoC.
	  This pin controller allows selecting the mux function for
	  each pin. This driver can also be built as a module called
	  pinctrl-k1.

config PINCTRL_SPACEMIT
	tristate
	depends on OF
	select GENERIC_PINCTRL_GROUPS
	select GENERIC_PINMUX_FUNCTIONS
	select GENERIC_PINCONF
	help
	  Say Y to select the pinctrl driver for K1 SoC.
	  This pin controller allows selecting the mux function for
	  each pin. This driver can also be built as a module called
	  pinctrl-k1.

config PINCTRL_K1PRO
	bool "Spacemit K1PRO pinctrl driver"
	depends on OF
	depends on SOC_SPACEMIT_K1_FPGA
	select PINCTRL_SPACEMIT
	help
	  Say Y here to enable the k1-pro pinctrl driver
```
