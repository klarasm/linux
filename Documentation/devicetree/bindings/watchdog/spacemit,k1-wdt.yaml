## Documentation/devicetree/bindings/watchdog/spacemit,k1-wdt.yaml
```yaml
# SPDX-License-Identifier: GPL-2.0-only OR BSD-2-Clause
%YAML 1.2
---
$id: http://devicetree.org/schemas/watchdog/spacemit,k1-wdt.yaml#
$schema: http://devicetree.org/meta-schemas/core.yaml#

title: Spacemit K1 watchdog

maintainers:
  - Klara Modin <klarasmodin@gmail.com>

allOf:
  - $ref: watchdog.yaml#

properties:
  compatible:
    items:
      - const: spacemit,k1-wdt

  reg:
    maxItems: 1

  clocks:
    maxItems: 2
    minItems: 2

  clock-names:
    items:
      - const: core
      - const: bus

  resets:
    maxItems: 1

required:
  - compatible
  - reg
  - clocks
  - clock-names
  - resets

unevaluatedProperties: false

examples:
  - |
    #include <dt-bindings/clock/spacemit,k1-syscon.h>

    watchdog@d4080000 {
            compatible = "spacemit,k1-wdt";
            reg = <0xd4080000 0xff>;
            clocks = <&syscon_mpmu CLK_WDT>,
                    <&syscon_mpmu CLK_WDT_BUS>;
            clock-names = "core", "bus";
            resets = <&syscon_mpmu RESET_WDT>;
    };
```
